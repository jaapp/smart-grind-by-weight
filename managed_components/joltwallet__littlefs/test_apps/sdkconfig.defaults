## managed_components/joltwallet__littlefs/test_apps/sdkconfig.defaults
```kconfig
# Use 4MB flash (partition table requires ~2.6MB)
CONFIG_ESPTOOLPY_FLASHSIZE_4MB=y

# General options for additional checks
CONFIG_HEAP_POISONING_COMPREHENSIVE=y
CONFIG_COMPILER_WARN_WRITE_STRINGS=y
CONFIG_FREERTOS_WATCHPOINT_END_OF_STACK=y
CONFIG_COMPILER_STACK_CHECK_MODE_STRONG=y
CONFIG_COMPILER_STACK_CHECK=y

# Disable the task watchdog since this app uses an interactive menu
CONFIG_ESP_TASK_WDT_INIT=n

# Custom partition table for this test app
CONFIG_PARTITION_TABLE_CUSTOM=y
CONFIG_PARTITION_TABLE_CUSTOM_FILENAME="partitions.csv"

# LittleFS settings for testing
CONFIG_LITTLEFS_USE_MTIME=y

# SPIFFS settings (for benchmark comparisons)
CONFIG_SPIFFS_USE_MTIME=y
CONFIG_SPIFFS_GC_MAX_RUNS=64
```

## sdkconfig.defaults
```kconfig
# =============================================================================
# sdkconfig.defaults — ESP32-S3 Smart Grind by Weight
# IDF 5.4 baseline configuration
# =============================================================================

# --- Target ---
CONFIG_IDF_TARGET="esp32s3"

# --- CPU ---
CONFIG_ESP32S3_DEFAULT_CPU_FREQ_240=y
CONFIG_ESP32S3_DEFAULT_CPU_FREQ_MHZ=240

# --- Flash ---
CONFIG_ESPTOOLPY_FLASHSIZE_16MB=y
CONFIG_ESPTOOLPY_FLASHSIZE="16MB"
CONFIG_ESPTOOLPY_FLASHMODE_QIO=y
CONFIG_ESPTOOLPY_FLASHFREQ_80M=y

# --- Partition table (custom: BLE delta OTA layout, was board_build.partitions) ---
CONFIG_PARTITION_TABLE_CUSTOM=y
CONFIG_PARTITION_TABLE_CUSTOM_FILENAME="partitions.csv"
CONFIG_PARTITION_TABLE_OFFSET=0x8000

# --- PSRAM (OPI PSRAM) ---
CONFIG_SPIRAM=y
CONFIG_SPIRAM_MODE_OCT=y
CONFIG_SPIRAM_SPEED_80M=y
CONFIG_SPIRAM_USE_MALLOC=y
CONFIG_SPIRAM_MALLOC_ALWAYSINTERNAL=16384
CONFIG_SPIRAM_TRY_ALLOCATE_WIFI_LWIP=y
# Allow heap allocations to fall back to PSRAM
CONFIG_SPIRAM_ALLOW_BSS_SEG_EXTERNAL_MEMORY=y

# --- Console / USB ---
CONFIG_ESP_CONSOLE_USB_SERIAL_JTAG=y
CONFIG_ESP_CONSOLE_SECONDARY_NONE=y

# --- Bluetooth / NimBLE ---
CONFIG_BT_ENABLED=y
CONFIG_BT_CONTROLLER_ENABLED=y
CONFIG_BT_NIMBLE_ENABLED=y
CONFIG_BT_NIMBLE_HOST_STACK_SIZE=8192
CONFIG_BT_NIMBLE_MAX_CONNECTIONS=2
# Disable Classic BT; BLE only
CONFIG_BT_CLASSIC_ENABLED=n

# --- LittleFS ---
CONFIG_LITTLEFS_MAX_PARTITIONS=4
CONFIG_LITTLEFS_PAGE_SIZE=256
CONFIG_LITTLEFS_OBJ_NAME_LEN=64
CONFIG_LITTLEFS_USE_MTIME=y

# --- FreeRTOS ---
CONFIG_FREERTOS_HZ=1000
CONFIG_FREERTOS_MAX_TASK_NAME_LEN=16

# --- Logging ---
CONFIG_LOG_DEFAULT_LEVEL_INFO=y
CONFIG_LOG_DEFAULT_LEVEL=3
CONFIG_LOG_MAXIMUM_LEVEL=4

# --- Heap diagnostics ---
CONFIG_HEAP_TRACING_DEST_STANDALONE=y

# --- Disable Arduino autostart (not applicable in pure IDF, but guard) ---
# CONFIG_AUTOSTART_ARDUINO is not set

# --- Compiler / optimization ---
CONFIG_COMPILER_OPTIMIZATION_PERF=y

# --- LVGL ---
# Use the project's hand-maintained include/lv_conf.h instead of Kconfig
# (required for custom fonts, PSRAM allocator, RGB565 color depth, etc.)
CONFIG_LV_CONF_SKIP=n
```
